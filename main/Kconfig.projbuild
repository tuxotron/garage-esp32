## main/Kconfig.projbuild
```kconfig
menu "Garage Door Opener"

config WIFI_SSID
    string "WiFi SSID"
    default "myssid"
    help
        SSID (network name) for the example to connect to.

config WIFI_PASSWORD
    string "WiFi Password"
    default "mypassword"
    help
        WiFi password (WPA or WPA2) for the example to use.

config MQTT_SERVER
    string "MQTT Server"
    default "iot.eclipse.org"
    help
        WiFi password (WPA or WPA2) for the example to use.

config MQTT_USERNAME
    string "MQTT Username"
    default ""
    help
        WiFi password (WPA or WPA2) for the example to use.

config MQTT_PASSWORD
    string "MQTT Password"
    default ""
    help
        WiFi password (WPA or WPA2) for the example to use.

endmenu
```
